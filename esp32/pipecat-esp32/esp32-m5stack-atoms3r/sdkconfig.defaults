## esp32/pipecat-esp32/esp32-m5stack-atoms3r/sdkconfig.defaults
```kconfig
CONFIG_IDF_TARGET="esp32s3"

# Enable PSRAM
CONFIG_SPIRAM=y
CONFIG_SPIRAM_MODE_QUAD=n
CONFIG_SPIRAM_MODE_OCT=y

# Performance
CONFIG_ESP_DEFAULT_CPU_FREQ_MHZ_240=y
CONFIG_FREERTOS_HZ=1000
CONFIG_COMPILER_OPTIMIZATION_PERF=y

# Enable DTLS
CONFIG_MBEDTLS_SSL_PROTO_DTLS=y

# Defaults to partitions.csv
CONFIG_PARTITION_TABLE_CUSTOM=y

# libpeer requires large stack allocations
CONFIG_ESP_MAIN_TASK_STACK_SIZE=16384
CONFIG_MBEDTLS_SSL_PROTO_DTLS=y
CONFIG_MBEDTLS_SSL_DTLS_SRTP=y
CONFIG_MBEDTLS_SSL_COOKIE_C=y
CONFIG_MBEDTLS_TIMING_C=y
CONFIG_MBEDTLS_X509_CREATE_C=y
CONFIG_MBEDTLS_X509_CRT_WRITE_C=y

# Use I2C0 for SCCB to avoid conflict with ES8311 on I2C1
CONFIG_SCCB_HARDWARE_I2C_PORT0=y
CONFIG_SCCB_HARDWARE_I2C_PORT1=n

# Explicitly enable the GC0308 camera sensor driver
CONFIG_GC0308_SUPPORT=y

# Use legacy SCCB I2C driver for compatibility
CONFIG_SCCB_HARDWARE_I2C_DRIVER_LEGACY=y
CONFIG_SCCB_HARDWARE_I2C_DRIVER_NEW=n
```
